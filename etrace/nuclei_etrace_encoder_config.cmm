PARAMETERS &encoder_arg &timestamp &datatrace

SYS.CONFIG.RVETRACE.TYPE standard
SYS.CONFIG.RVETRACE.BASE &encoder_arg 

RVETRACE.DATATRACE &datatrace
RVETRACE.DATASUPPRESS ON

RVETRACE.TRACEID AUTO
RVETRACE.TIMESTAMPS &timestamp

RVETRACE.ON