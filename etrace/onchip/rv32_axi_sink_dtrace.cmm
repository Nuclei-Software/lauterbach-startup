PMACRO.EXPLICIT          ; 强制显式变量声明

; ============================================================================
; 全局配置参数
; ============================================================================
GLOBAL &elf_file_path &nuclei_home
GLOBAL &rvetrace_base &rvfunnel1_base &rvsmem_base
GLOBAL &trace_dump_base &trace_dump_size

// 变量设置, 用户需要修改如下的配置
&rvfunnel1_base=0x10060000   ; Funnel基地址 
&rvsmem_base=0x10061000      ; AXI SINK基地址 
&rvetrace_base=0x10064000    ; Encoder基地址
&nuclei_home="~~/lauterbach-startup" ; nuclei lauterbach-startup仓库本地路径
&elf_file_path="C:\Users\Administrator\NucleiStudio_workspace\freertos_rv32\Debug\freertos_rv32.elf" ; elf文件路径
&trace_dump_base=0xa0100000  ; trace数据保存内存的基地址
&trace_dump_size=0x30000     ; trace数据保存内存的大小, 以字节为单位

IF FILE.EXIST("&nuclei_home/nuclei_custom_inst_parser.dll")==FALSE()
(
    PRINT "Please set the correct nuclei_home path"
    ENDDO
)

SYS.Reset
WinClear
SYS.CPU RV32
SYS.CONFIG.CORENUMBER 1.
SYS.CONFIG.HART.INDEX 0.
SYS.OPTION RESETMODE NDMRST
SYS.OPTION RESETDETECTION NONE
area
SYS.UP

; ============================================================================
; Nuclei ETrace 配置
; ============================================================================
PRINT %COLOR.GREEN "Configuring RV Encoder..."
do &nuclei_home\etrace\nuclei_etrace_encoder_config.cmm "SB:&rvetrace_base"  \
                                                        "ON" \
                                                        "ON"

PRINT %COLOR.GREEN "Configuring RV Encoder analyze..."
do &nuclei_home\etrace\nuclei_etrace_analyze_config.cmm "&rvetrace_base"

PRINT %COLOR.GREEN "Configuring RV Funnel..."
do &nuclei_home\etrace\nuclei_etrace_funnel_config.cmm "&rvfunnel1_base" \
                                                       "RVETRACE 0" 

PRINT %COLOR.GREEN "Configuring RV AXI SINK..."
do &nuclei_home\etrace\nuclei_etrace_axi_sink_config.cmm "&rvsmem_base" \
                                                         "&trace_dump_base" \
                                                         "&trace_dump_size" \
                                                         "fifo"

trace.clock 16M ; 配置trace的时钟


IF FILE.EXIST(&elf_file_path)
(
    PRINT "ELF File: " "&elf_file_path"
    Data.LOAD.ELF &elf_file_path 
)
ELSE
(
    PRINT "文件不存在或无法打开！请额外使用 Data.LOAD.ELF命令加载elf"
)

PRINT %COLOR.GREEN "Initializing Trace..."

apu.load &nuclei_home\nuclei_custom_inst_parser.dll
PER ~~\perriscvetrace.per
PER &nuclei_home\nuclei_custom_csr_parser.per

ENDDO

