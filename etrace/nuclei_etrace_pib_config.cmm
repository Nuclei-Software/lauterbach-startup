PARAMETERS &rvpib_base &portsize 

SYS.CONFIG.RVPIB.BASE SB:&rvpib_base
SYS.CONFIG.RVPIB.TRACESOURCE RVFUNNEL1

RVPIB.PORTSIZE &portsize
RVPIB.PORTMODE PARALLEL
RVPIB.CLOCKDIVIDER 1.

SYSTEM.CONFIG.TRACEPORT TYPE PTI
SYSTEM.CONFIG.TRACEPORT.TRACESOURCE RVPIB

TRACE.TERMINATION OFF
TRACE.AUTOFOCUS