RESet

system.jtagclock 10MHz
SYStem.Option.RESetmode NDMRST
SYStem.cpu RV32
SETUP.DIS AbiNames
system.config.CoreNumber 2.
system.config.hart.INDEX 0 0
CORE.ASSIGN 1.  2.

SYStem.CONFIG RVDMIAP1.DebugSource DebugPort
SYStem.CONFIG RVDMIAP1.IRLENGTH 5.
SYStem.CONFIG RVDMIAP1.IRPRE 0.
SYStem.CONFIG RVDMIAP1.IRPOST 5.
SYStem.CONFIG RVDMIAP1.DRPRE 0.
SYStem.CONFIG RVDMIAP1.DRPOST 1.

SYStem.CONFIG RVDMIAP2.DebugSource DebugPort
SYStem.CONFIG RVDMIAP2.IRLENGTH 5.
SYStem.CONFIG RVDMIAP2.IRPRE 5.
SYStem.CONFIG RVDMIAP2.IRPOST 0.
SYStem.CONFIG RVDMIAP2.DRPRE 1.
SYStem.CONFIG RVDMIAP2.DRPOST 0.

SYStem.CONFIG COREDEBUG.Base DMI:0x0 dmi2:0x0

SYStem.attach

if run()
break

wait 1.s

enddo
