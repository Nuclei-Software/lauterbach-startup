area.clear
area
RESet

system.jtagclock 10MHz
SYStem.Option.RESetmode NDMRST
SYStem.cpu RV64
SETUP.DIS AbiNames

SYStem.CONFIG RVDMIAP1.DebugSource DebugPort
SYStem.CONFIG RVDMIAP1.IRLENGTH 5.
SYStem.CONFIG RVDMIAP1.IRPRE 0.
SYStem.CONFIG RVDMIAP1.IRPOST 0.
SYStem.CONFIG RVDMIAP1.DRPRE 0.
SYStem.CONFIG RVDMIAP1.DRPOST 0.
SYStem.CONFIG COREDEBUG.Base DMI:0x0

SYStem.CONFIG CoreNumber 8.
SYStem.CONFIG HART.INDEX 0. 1. 2. 3. 4. 5. 6. 7.
CORE.ASSIGN 1. 2. 3. 4. 5. 6. 7. 8.

SYStem.Up

apu.load ~~~~/nuclei_custom_inst_parser.dll
per ~~~~/nuclei_custom_csr_parser.per

list

enddo